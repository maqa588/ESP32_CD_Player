## main/Kconfig.projbuild
```kconfig
menu "ESP32 AirPlay Configuration"

    config AIRPLAY_WIFI_SSID
        string "WiFi SSID"
        default "Your_WiFi_SSID"
        help
            SSID of the WiFi Access Point that the ESP32 AirPlay receiver should connect to.

    config AIRPLAY_WIFI_PASSWORD
        string "WiFi Password"
        default "Your_WiFi_Password"
        help
            Password of the WiFi Access Point.

    config AIRPLAY_DEVICE_NAME
        string "AirPlay Device Name"
        default "ESP32-CD-AirPlay"
        help
            The name displayed on Apple devices in AirPlay list.

endmenu
```

## sdkconfig.defaults
```kconfig
CONFIG_IDF_TARGET="esp32s3"

# Flash configuration (16MB)
CONFIG_ESPTOOLPY_FLASHSIZE_16MB=y
CONFIG_ESPTOOLPY_FLASHSIZE="16MB"

# Partition table
CONFIG_PARTITION_TABLE_CUSTOM=y
CONFIG_PARTITION_TABLE_CUSTOM_FILENAME="partitions.csv"
CONFIG_PARTITION_TABLE_FILENAME="partitions.csv"

# PSRAM / SPIRAM configuration for ESP32-S3 N16R8 (8MB Octal PSRAM)
CONFIG_SPIRAM=y
CONFIG_SPIRAM_MODE_OCT=y
CONFIG_SPIRAM_TYPE_AUTO=y
CONFIG_SPIRAM_SPEED_80M=y
CONFIG_SPIRAM_BOOT_INIT=y
CONFIG_SPIRAM_USE_MALLOC=y
CONFIG_SPIRAM_MEMTEST=y
CONFIG_SPIRAM_TRY_ALLOCATE_WIFI_LWIP=y
CONFIG_SPIRAM_MALLOC_ALWAYSINTERNAL=512
CONFIG_SPIRAM_ALLOW_STACK_EXTERNAL_MEMORY=y

# FreeRTOS & Stack
CONFIG_FREERTOS_HZ=1000

# Wi-Fi & LwIP performance
CONFIG_LWIP_MAX_SOCKETS=16
CONFIG_LWIP_SO_RCVBUF=y
CONFIG_LWIP_TCP_MSS=1460
CONFIG_LWIP_TCP_SND_BUF_DEFAULT=5760
CONFIG_LWIP_TCP_WND_DEFAULT=5760

CONFIG_ESP_SYSTEM_EVENT_TASK_STACK_SIZE=4096

# mDNS SPIRAM allocation
CONFIG_MDNS_TASK_CREATE_FROM_SPIRAM=y
CONFIG_MDNS_MEMORY_ALLOC_SPIRAM=y
```
